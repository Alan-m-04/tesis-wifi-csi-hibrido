## firmware/mesh_csi_experimental/main/Kconfig.projbuild
```kconfig
menu "TESIS experimental Mesh/CSI (not approved for physical acquisition)"
config TESIS_EXP_NODE_ID
    int "Node label: 0=TX-01/root, 1=RX-01, 2=RX-02"
    range 0 2
    default 1
config TESIS_EXP_ROUTER_SSID
    string "Local Ubuntu hotspot SSID (do not commit credentials)"
    default ""
config TESIS_EXP_ROUTER_PASSWORD
    string "Hotspot password"
    default ""
config TESIS_EXP_MESH_PASSWORD
    string "Mesh softAP password: 8-63 characters"
    default ""
config TESIS_EXP_SOURCE_MAC
    string "Sensor RF source MAC: lowercase/uppercase colon notation"
    default ""
config TESIS_EXP_HZ
    int "Candidate probe cycles per second; delivered CSI rate is measured separately"
    range 1 100
    default 5
config TESIS_EXP_CSI_MAX_BYTES
    int "Largest admissible CSI buffer (oversize is counted and rejected, never truncated)"
    range 2 1024
    default 256
endmenu
```

## firmware/mesh_csi_experimental/sdkconfig.defaults
```kconfig
CONFIG_IDF_TARGET="esp32s3"
CONFIG_ESP_CONSOLE_UART_DEFAULT=y
CONFIG_ESP_CONSOLE_UART_BAUDRATE=921600
CONFIG_ESPTOOLPY_MONITOR_BAUD=921600
CONFIG_ESP_WIFI_CSI_ENABLED=y
CONFIG_FREERTOS_HZ=1000
CONFIG_ESPTOOLPY_FLASHSIZE_16MB=y
CONFIG_ESPTOOLPY_FLASHMODE_DIO=y
CONFIG_ESPTOOLPY_FLASHFREQ_80M=y
CONFIG_LOG_DEFAULT_LEVEL_NONE=y
# CONFIG_SPIRAM is not set
```
